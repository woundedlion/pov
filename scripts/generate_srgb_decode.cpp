// Emits core/color/srgb_decode_lut.h: the two-region split-decode tables for
// linear16->sRGB8, derived from the exact linear_to_srgb_lut. A fine 16-wide
// low region [0, VSPLIT) and a coarse 128-wide high region [VSPLIT, 65536),
// each bucket holding <=1 output step, so the decode is a single branchless
// compare per region. Asserts the <=1-step property and self-verifies
// bit-exactness over all 65536 inputs. Total ~1.5 KB (fits the DTCM slack).
// Build: clang++ -std=c++20 -I. -Icore scripts/generate_srgb_decode.cpp
// (unit_srgb_decode re-checks the equivalence in CI).
#include "core/color/color_luts.h"
#include <cstdint>
#include <cstdio>

static constexpr int VSPLIT = 4096;
static constexpr int LOW_SHIFT = 4;                           // 16-wide
static constexpr int HIGH_SHIFT = 7;                          // 128-wide
static constexpr int LOW_N = VSPLIT >> LOW_SHIFT;             // 256
static constexpr int HIGH_N = (65536 - VSPLIT) >> HIGH_SHIFT; // 480

// Pack one bucket [base_v, base_v+width) into (step<<8)|base; step is the
// offset in [0,width] where the output increments (== width if constant).
// Returns false if the bucket holds more than one step (bucketing too coarse).
static bool pack_bucket(int base_v, int width, uint16_t &out) {
  int base = linear_to_srgb_lut[base_v];
  int step = width, seen = 0, cur = base;
  for (int k = 1; k < width && base_v + k < 65536; ++k) {
    int val = linear_to_srgb_lut[base_v + k];
    if (val != cur) {
      if (++seen > 1)
        return false;
      if (val == base + 1)
        step = k;
      cur = val;
    }
  }
  out = (uint16_t)((step << 8) | (base & 0xFF));
  return true;
}

static uint8_t decode(int v, const uint16_t *low, const uint16_t *high) {
  if (v < VSPLIT) {
    uint16_t e = low[v >> LOW_SHIFT];
    return (uint8_t)((e & 0xFF) +
                     (((v & ((1 << LOW_SHIFT) - 1)) >= (e >> 8)) ? 1 : 0));
  }
  int d = v - VSPLIT;
  uint16_t e = high[d >> HIGH_SHIFT];
  return (uint8_t)((e & 0xFF) +
                   (((d & ((1 << HIGH_SHIFT) - 1)) >= (e >> 8)) ? 1 : 0));
}

int main() {
  static uint16_t low[LOW_N], high[HIGH_N];
  for (int i = 0; i < LOW_N; ++i)
    if (!pack_bucket(i << LOW_SHIFT, 1 << LOW_SHIFT, low[i])) {
      std::printf("FAIL: low bucket %d has >1 step\n", i);
      return 1;
    }
  for (int i = 0; i < HIGH_N; ++i)
    if (!pack_bucket(VSPLIT + (i << HIGH_SHIFT), 1 << HIGH_SHIFT, high[i])) {
      std::printf("FAIL: high bucket %d has >1 step\n", i);
      return 1;
    }
  long mism = 0;
  for (int v = 0; v < 65536; ++v)
    if (decode(v, low, high) != linear_to_srgb_lut[v])
      ++mism;
  std::printf("low=%d high=%d bytes=%d  mismatches=%ld / 65536\n", LOW_N,
              HIGH_N, (LOW_N + HIGH_N) * 2, mism);
  if (mism)
    return 1;

  FILE *f = std::fopen("core/color/srgb_decode_lut.h", "w");
  std::fprintf(f, "#pragma once\n#include \"engine/platform.h\"\n");
  std::fprintf(f, "// Generated by scripts/generate_srgb_decode.cpp from "
                  "linear_to_srgb_lut.\n");
  std::fprintf(f,
               "// Two-region split-decode of linear16->sRGB8: 16-wide low "
               "[0,%d), 128-wide high.\n",
               VSPLIT);
  std::fprintf(f,
               "// Entry: low byte = base output, high byte = step point.\n");
  std::fprintf(f, "inline constexpr int SRGB_DECODE_VSPLIT = %d;\n", VSPLIT);
  auto emit = [&](const char *name, const uint16_t *t, int n) {
    std::fprintf(f, "// clang-format off\n");
    std::fprintf(f, "inline const uint16_t %s[%d] PROGMEM = {\n", name, n);
    for (int i = 0; i < n; ++i) {
      if (i % 12 == 0)
        std::fprintf(f, "    ");
      std::fprintf(f, "0x%04x,", t[i]);
      std::fprintf(f, (i % 12 == 11) ? "\n" : " ");
    }
    std::fprintf(f, "\n};\n// clang-format on\n");
  };
  emit("srgb_decode_low_src", low, LOW_N);
  emit("srgb_decode_high_src", high, HIGH_N);
  std::fclose(f);
  std::printf("wrote core/color/srgb_decode_lut.h\n");
  return 0;
}
